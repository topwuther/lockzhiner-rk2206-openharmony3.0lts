## drivers/adapter/khdf/liteos/model/usb/host/Kconfig
```kconfig
# Copyright (c) 2020-2021 Huawei Device Co., Ltd. All rights reserved.
#
# Redistribution and use in source and binary forms, with or without modification,
# are permitted provided that the following conditions are met:
#
# 1. Redistributions of source code must retain the above copyright notice, this list of
#    conditions and the following disclaimer.
#
# 2. Redistributions in binary form must reproduce the above copyright notice, this list
#    of conditions and the following disclaimer in the documentation and/or other materials
#    provided with the distribution.
#
# 3. Neither the name of the copyright holder nor the names of its contributors may be used
#    to endorse or promote products derived from this software without specific prior written
#    permission.
#
# THIS SOFTWARE IS PROVIDED BY THE COPYRIGHT HOLDERS AND CONTRIBUTORS
# "AS IS" AND ANY EXPRESS OR IMPLIED WARRANTIES, INCLUDING, BUT NOT LIMITED TO,
# THE IMPLIED WARRANTIES OF MERCHANTABILITY AND FITNESS FOR A PARTICULAR
# PURPOSE ARE DISCLAIMED. IN NO EVENT SHALL THE COPYRIGHT HOLDER OR
# CONTRIBUTORS BE LIABLE FOR ANY DIRECT, INDIRECT, INCIDENTAL, SPECIAL,
# EXEMPLARY, OR CONSEQUENTIAL DAMAGES (INCLUDING, BUT NOT LIMITED TO,
# PROCUREMENT OF SUBSTITUTE GOODS OR SERVICES; LOSS OF USE, DATA, OR PROFITS;
# OR BUSINESS INTERRUPTION) HOWEVER CAUSED AND ON ANY THEORY OF LIABILITY,
# WHETHER IN CONTRACT, STRICT LIABILITY, OR TORT (INCLUDING NEGLIGENCE OR
# OTHERWISE) ARISING IN ANY WAY OUT OF THE USE OF THIS SOFTWARE, EVEN IF
# ADVISED OF THE POSSIBILITY OF SUCH DAMAGE.

config DRIVERS_HDF_USB_DDK_HOST
    bool "Enable HDF LiteOS USB DDK HOST driver"
    default y
    depends on DRIVERS_HDF && DRIVERS_USB
    help
        Answer Y to choice HDF LiteOS USB DDK HOST driver.

config DRIVERS_HDF_USB_PNP_NOTIFY
    bool "Enable HDF LiteOS USB PNP Notify driver"
    default y
    depends on DRIVERS_HDF && DRIVERS_USB
    help
        Answer Y to choice HDF LiteOS USB PNP Notify driver.

config DRIVERS_HDF_USB_HOST_SERIAL
    bool "Enable HDF usb host serial driver"
    default y
    depends on DRIVERS_HDF && DRIVERS_USB
    help
      Answer Y to enable HDF usb host serial driver.

config DRIVERS_HDF_USB_HOST_SERIAL_RAW
    bool "Enable HDF usb host serial raw driver"
    default y
    depends on DRIVERS_HDF && DRIVERS_USB
    help
      Answer Y to enable HDF usb host serial driver.

config DRIVERS_HDF_USB_HOST_NET
    bool "Enable HDF usb host net driver"
    default y
    depends on DRIVERS_HDF && DRIVERS_USB
    help
      Answer Y to enable HDF usb host net driver.

config DRIVERS_HDF_USB_HOST_SDK_API_SPEED
    bool "Enable HDF usb host sdk api speed driver"
    default y
    depends on DRIVERS_HDF && DRIVERS_USB
    help
      Answer Y to enable HDF usb host sdk api speed test driver.

config DRIVERS_HDF_USB_HOST_SDK_RAW_SPEED
    bool "Enable HDF usb host sdk raw api speed driver"
    default y
    depends on DRIVERS_HDF && DRIVERS_USB
    help
      Answer Y to enable HDF usb host sdk raw api speed test driver.

config DRIVERS_HDF_USB_HOST_NO_SDK_SPEED
    bool "Enable HDF usb host no sdk speed driver"
    default y
    depends on DRIVERS_HDF && DRIVERS_USB
    help
      Answer Y to enable HDF usb host no sdk speed test driver.
```

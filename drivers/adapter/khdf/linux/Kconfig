## drivers/adapter/khdf/linux/Kconfig
```kconfig
config DRIVERS_HDF
    bool "Enable HDF manager"
    default y
    help
      Answer Y to enable Linux support HDF.

config HDF_SUPPORT_LEVEL
    int "Set HDF support platform"
    default 1
    range 0 5
    depends on DRIVERS_HDF
    help
      Answer 1 on OHOS L1, 2 on OHOS L2, etc

source "drivers/hdf/khdf/platform/Kconfig"
source "drivers/hdf/khdf/test/Kconfig"
source "drivers/hdf/khdf/model/display/Kconfig"
source "drivers/hdf/khdf/model/input/Kconfig"
source "drivers/hdf/khdf/model/network/wifi/Kconfig"
source "drivers/hdf/khdf/model/network/bluetooth/Kconfig"
source "drivers/hdf/khdf/model/sensor/Kconfig"
source "drivers/hdf/khdf/model/storage/Kconfig"
source "drivers/hdf/khdf/model/usb/host/Kconfig"
source "drivers/hdf/khdf/model/usb/device/Kconfig"
source "drivers/hdf/khdf/model/audio/Kconfig"
source "drivers/hdf/khdf/model/misc/vibrator/Kconfig"
source "drivers/hdf/khdf/model/misc/dsoftbus/Kconfig"
```

## drivers/adapter/khdf/linux/model/audio/Kconfig
```kconfig
config DRIVERS_HDF_AUDIO
    bool "Enable HDF Audio driver"
    default y
    depends on DRIVERS_HDF
    help
        Answer Y to choice HDF Audio input driver.

config DRIVERS_HDF_AUDIO_TEST
    bool "Enable HDF Audio Test driver"
    default n
    depends on DRIVERS_HDF_AUDIO
    help
        Answer Y to choice HDF Audio Test input driver.
```

## drivers/adapter/khdf/linux/model/display/Kconfig
```kconfig
config DRIVERS_HDF_DISP
    bool "Enable HDF Display driver"
    default n
    depends on DRIVERS_HDF
    help
        Answer Y to choice HDF Display driver.
config DRIVERS_HDF_LCDKIT
    bool "Enable HDF Lcdkit driver"
    default n
    depends on DRIVERS_HDF_DISP
    help
        Answer Y to enable HDF Lcdkit driver.
config DRIVERS_HDF_LCD_ICN9700
    bool "Enable HDF Icn9700 driver"
    default n
    depends on DRIVERS_HDF_DISP
    help
        Answer Y to enable HDF Icn9700 driver.
config DRIVERS_HDF_LCD_ST7789
    bool "Enable HDF St7789 driver"
    default n
    depends on DRIVERS_HDF_DISP
    help
        Answer Y to enable HDF St7789 driver.
```

## drivers/adapter/khdf/linux/model/input/Kconfig
```kconfig
config DRIVERS_HDF_INPUT
    bool "Enable HDF input driver"
    default n
    depends on DRIVERS_HDF
    help
      Answer Y to enable HDF input driver.

config DRIVERS_HDF_TP_5P5_GT911
    bool "Enable HDF tp 5P5 GT911 driver"
    default n
    depends on DRIVERS_HDF_INPUT
    help
      Answer Y to enable HDF TP 5P5 GT911 driver.

config DRIVERS_HDF_TP_2P35_FT6236
    bool "Enable HDF tp 2P35 FT6236 driver"
    default n
    depends on DRIVERS_HDF_INPUT
    help
      Answer Y to enable HDF TP 2P35 FT6236 driver.
```

## drivers/adapter/khdf/linux/model/misc/dsoftbus/Kconfig
```kconfig
# Copyright (c) 2021 Huawei Device Co., Ltd.
#
# This software is licensed under the terms of the GNU General Public
# License version 2, as published by the Free Software Foundation, and
# may be copied, distributed, and modified under those terms.
#
# This program is distributed in the hope that it will be useful,
# but WITHOUT ANY WARRANTY; without even the implied warranty of
# MERCHANTABILITY or FITNESS FOR A PARTICULAR PURPOSE. See the
# GNU General Public License for more details.

config DRIVERS_HDF_DSOFTBUS
    bool "Enable HDF dsoftbus driver"
    default n
    depends on DRIVERS_HDF
    help
      control HDF dsoftbus driver capability.

config DSOFTBUS_WLAN_PARAM_MONITOR
    bool "enable dsoftbus wlan parameter monitor"
    default n
    depends on DRIVERS_HDF_DSOFTBUS
    help
      control hdf dsoftbus wlan parameter monitor capability.
```

## drivers/adapter/khdf/linux/model/misc/vibrator/Kconfig
```kconfig
# Copyright (c) 2021 Huawei Device Co., Ltd.
#
# This software is licensed under the terms of the GNU General Public
# License version 2, as published by the Free Software Foundation, and
# may be copied, distributed, and modified under those terms.
#
# This program is distributed in the hope that it will be useful,
# but WITHOUT ANY WARRANTY; without even the implied warranty of
# MERCHANTABILITY or FITNESS FOR A PARTICULAR PURPOSE. See the
# GNU General Public License for more details.

config DRIVERS_HDF_VIBRATOR
    bool "Enable HDF vibrator driver"
    default n
    depends on DRIVERS_HDF
    help
      Answer Y to enable HDF vibrator driver.

config DRIVERS_HDF_VIBRATOR_LINEAR
    bool "Enable HDF linear vibrator driver"
    default n
    depends on DRIVERS_HDF_VIBRATOR
    help
      Answer Y to enable HDF linear vibrator driver.
```

## drivers/adapter/khdf/linux/model/network/bluetooth/Kconfig
```kconfig
config DRIVERS_HDF_BT
    bool "Enable HDF Bluetooth"
    default n
    depends on DRIVERS_HDF
    help
      Answer Y to enable HDF bluetooth.
```

## drivers/adapter/khdf/linux/model/network/wifi/Kconfig
```kconfig
config DRIVERS_HDF_WIFI
    bool "Enable HDF wifi"
    default n
    depends on DRIVERS_HDF
    help
      Answer Y to enable HDF wifi.

config DRIVERS_HI3881
    bool "Enable hi3881"
    default n
    depends on DRIVERS_HDF_WIFI
    help
      Answer Y to enable hi3881 wifi chip driver.
```

## drivers/adapter/khdf/linux/model/sensor/Kconfig
```kconfig
# Copyright (c) 2021 Huawei Device Co., Ltd.
#
# This software is licensed under the terms of the GNU General Public
# License version 2, as published by the Free Software Foundation, and
# may be copied, distributed, and modified under those terms.
#
# This program is distributed in the hope that it will be useful,
# but WITHOUT ANY WARRANTY; without even the implied warranty of
# MERCHANTABILITY or FITNESS FOR A PARTICULAR PURPOSE. See the
# GNU General Public License for more details.

config DRIVERS_HDF_SENSOR
    bool "Enable HDF sensor driver"
    default n
    depends on DRIVERS_HDF
    help
      Answer Y to enable HDF sensor driver.

config DRIVERS_HDF_SENSOR_ACCEL
    bool "Enable HDF accel sensor driver"
    default n
    depends on DRIVERS_HDF_SENSOR
    help
      Answer Y to enable HDF accel sensor driver.
config DRIVERS_HDF_SENSOR_ACCEL_BMI160
    bool "Enable HDF accel sensor driver"
    default n
    depends on DRIVERS_HDF_SENSOR_ACCEL
    help
      Answer Y to enable HDF accel bmi160 sensor driver.
config DRIVERS_HDF_SENSOR_GYRO
    bool "Enable HDF gyro sensor driver"
    default n
    depends on DRIVERS_HDF_SENSOR
    help
      Answer Y to enable HDF gyro sensor driver.
config DRIVERS_HDF_SENSOR_BAROMETER
    bool "Enable HDF barometer sensor driver"
    default n
    depends on DRIVERS_HDF_SENSOR
    help
      Answer Y to enable HDF barometer sensor driver.
config DRIVERS_HDF_SENSOR_BAROMETER_BMP180
    bool "Enable HDF barometer sensor driver"
    default n
    depends on DRIVERS_HDF_SENSOR_BAROMETER
    help
      Answer Y to enable HDF barometer bmp180 sensor driver.
config DRIVERS_HDF_SENSOR_HALL
    bool "Enable HDF hall sensor driver"
    default n
    depends on DRIVERS_HDF_SENSOR
    help
      Answer Y to enable HDF hall sensor driver.
config DRIVERS_HDF_SENSOR_HALL_AK8789
    bool "Enable HDF hall sensor driver"
    default n
    depends on DRIVERS_HDF_SENSOR_HALL
    help
      Answer Y to enable HDF hall ak8789 sensor driver.
```

## drivers/adapter/khdf/linux/model/storage/Kconfig
```kconfig
# Copyright (c) 2021 Huawei Device Co., Ltd.
#
# This software is licensed under the terms of the GNU General Public
# License version 2, as published by the Free Software Foundation, and
# may be copied, distributed, and modified under those terms.
#
# This program is distributed in the hope that it will be useful,
# but WITHOUT ANY WARRANTY; without even the implied warranty of
# MERCHANTABILITY or FITNESS FOR A PARTICULAR PURPOSE. See the
# GNU General Public License for more details.

config DRIVERS_HDF_STORAGE
    bool "Enable HDF storage driver"
    default n
    depends on DRIVERS_HDF
    help
      Answer Y to enable HDF storage driver.
```

## drivers/adapter/khdf/linux/model/usb/device/Kconfig
```kconfig
config DRIVERS_HDF_USB_F_GENERIC
    bool "Enable F_GENERIC driver"
    default y
    depends on DRIVERS_HDF
    help
        Answer Y to choice HDF USB F_GENERIC driver.
```

## drivers/adapter/khdf/linux/model/usb/host/Kconfig
```kconfig
# Copyright (c) 2021 Huawei Device Co., Ltd.
#
# This software is licensed under the terms of the GNU General Public
# License version 2, as published by the Free Software Foundation, and
# may be copied, distributed, and modified under those terms.
#
# This program is distributed in the hope that it will be useful,
# but WITHOUT ANY WARRANTY; without even the implied warranty of
# MERCHANTABILITY or FITNESS FOR A PARTICULAR PURPOSE. See the
# GNU General Public License for more details.

config DRIVERS_HDF_USB_PNP_NOTIFY
    bool "Enable HDF USB PNP Notify driver"
    default y
    depends on DRIVERS_HDF
    help
        Answer Y to choice HDF USB PNP Notify driver.
```

## drivers/adapter/khdf/linux/platform/Kconfig
```kconfig
config DRIVERS_HDF_PLATFORM
    bool "Enable HDF platform driver"
        default n
    depends on DRIVERS_HDF
        help
      Answer Y to enable HDF platform driver.

config DRIVERS_HDF_PLATFORM_MIPI_DSI
    bool "Enable HDF platform mipi dsi driver"
    default n
    depends on DRIVERS_HDF_PLATFORM
    help
      Answer Y to enable HDF platform mipi dsi driver.

config DRIVERS_HDF_PLATFORM_GPIO
    bool "Enable HDF platform gpio driver"
    default n
    depends on DRIVERS_HDF_PLATFORM
    help
      Answer Y to enable HDF platform gpio driver.

config DRIVERS_HDF_PLATFORM_I2C
    bool "Enable HDF platform i2c driver"
    default n
    depends on DRIVERS_HDF_PLATFORM
    help
      Answer Y to enable HDF platform i2c driver.

config DRIVERS_HDF_PLATFORM_WATCHDOG
    bool "Enable HDF platform watchdog driver"
    default n
    depends on DRIVERS_HDF_PLATFORM
    help
      Answer Y to enable HDF platform watchdog driver.

config PWM_HI35XX
    bool "hi35xx pwm driver"
    depends on PWM
    help
      Answer Y to enable hi35xx pwm driver

config DRIVERS_HDF_PLATFORM_PWM
    bool "Enable HDF platform pwm driver"
    depends on DRIVERS_HDF_PLATFORM
    help
      Answer Y to enable HDF platform pwm driver.

config DRIVERS_HDF_PLATFORM_UART
    bool "Enable HDF platform uart driver"
    depends on DRIVERS_HDF_PLATFORM
    help
      Answer Y to enable HDF platform uart driver.

config DRIVERS_HDF_PLATFORM_SDIO
    bool "Enable HDF platform sdio driver"
    default n
    depends on DRIVERS_HDF_PLATFORM
    help
      Answer Y to enable HDF platform sdio driver.

config DRIVERS_HDF_PLATFORM_EMMC
    bool "Enable HDF platform emmc driver"
    default n
    depends on DRIVERS_HDF_PLATFORM
    help
      Answer Y to enable HDF platform emmc driver.

config DRIVERS_HDF_PLATFORM_MMC
    bool "Enable HDF platform mmc driver"
    default n
    depends on DRIVERS_HDF_PLATFORM
    help
      Answer Y to enable HDF platform mmc driver.

config DRIVERS_HDF_PLATFORM_SPI
    bool "Enable HDF platform spi driver"
    default n
    depends on DRIVERS_HDF_PLATFORM
    help
      Answer Y to enable HDF platform spi driver.

config DRIVERS_HDF_PLATFORM_RTC
    bool "Enable HDF platform rtc driver"
    default n
    depends on DRIVERS_HDF_PLATFORM
    help
      Answer Y to enable HDF platform rtc driver.
```

## drivers/adapter/khdf/liteos/model/sensor/Kconfig
```kconfig
# Copyright (c) 2021 Huawei Device Co., Ltd. All rights reserved.
#
# Redistribution and use in source and binary forms, with or without modification,
# are permitted provided that the following conditions are met:
#
# 1. Redistributions of source code must retain the above copyright notice, this list of
#    conditions and the following disclaimer.
#
# 2. Redistributions in binary form must reproduce the above copyright notice, this list
#    of conditions and the following disclaimer in the documentation and/or other materials
#    provided with the distribution.
#
# 3. Neither the name of the copyright holder nor the names of its contributors may be used
#    to endorse or promote products derived from this software without specific prior written
#    permission.
#
# THIS SOFTWARE IS PROVIDED BY THE COPYRIGHT HOLDERS AND CONTRIBUTORS
# "AS IS" AND ANY EXPRESS OR IMPLIED WARRANTIES, INCLUDING, BUT NOT LIMITED TO,
# THE IMPLIED WARRANTIES OF MERCHANTABILITY AND FITNESS FOR A PARTICULAR
# PURPOSE ARE DISCLAIMED. IN NO EVENT SHALL THE COPYRIGHT HOLDER OR
# CONTRIBUTORS BE LIABLE FOR ANY DIRECT, INDIRECT, INCIDENTAL, SPECIAL,
# EXEMPLARY, OR CONSEQUENTIAL DAMAGES (INCLUDING, BUT NOT LIMITED TO,
# PROCUREMENT OF SUBSTITUTE GOODS OR SERVICES; LOSS OF USE, DATA, OR PROFITS;
# OR BUSINESS INTERRUPTION) HOWEVER CAUSED AND ON ANY THEORY OF LIABILITY,
# WHETHER IN CONTRACT, STRICT LIABILITY, OR TORT (INCLUDING NEGLIGENCE OR
# OTHERWISE) ARISING IN ANY WAY OUT OF THE USE OF THIS SOFTWARE, EVEN IF
# ADVISED OF THE POSSIBILITY OF SUCH DAMAGE.

config DRIVERS_HDF_SENSOR
    bool "Enable HDF sensor driver"
    default n
    depends on DRIVERS_HDF
    help
      Answer Y to enable HDF sensor driver.

config DRIVERS_HDF_SENSOR_ACCEL
    bool "Enable HDF accel sensor driver"
    default n
    depends on DRIVERS_HDF_SENSOR
    help
      Answer Y to enable HDF accel sensor driver.
config DRIVERS_HDF_SENSOR_ACCEL_BMI160
    bool "Enable HDF accel sensor driver"
    default n
    depends on DRIVERS_HDF_SENSOR_ACCEL
    help
      Answer Y to enable HDF accel bmi160 sensor driver.
config DRIVERS_HDF_SENSOR_GYRO
    bool "Enable HDF gyro sensor driver"
    default n
    depends on DRIVERS_HDF_SENSOR
    help
      Answer Y to enable HDF gyro sensor driver.
config DRIVERS_HDF_SENSOR_BAROMETER
    bool "Enable HDF barometer sensor driver"
    default n
    depends on DRIVERS_HDF_SENSOR
    help
      Answer Y to enable HDF barometer sensor driver.
config DRIVERS_HDF_SENSOR_BAROMETER_BMP180
    bool "Enable HDF barometer sensor driver"
    default n 
    depends on DRIVERS_HDF_SENSOR_BAROMETER
    help
      Answer Y to enable HDF barometer bmp180 sensor driver.
config DRIVERS_HDF_SENSOR_HALL
    bool "Enable HDF hall sensor driver"
    default n
    depends on DRIVERS_HDF_SENSOR
    help
      Answer Y to enable HDF hall sensor driver.
config DRIVERS_HDF_SENSOR_HALL_AK8789
    bool "Enable HDF hall sensor driver"
    default n
    depends on DRIVERS_HDF_SENSOR_HALL
    help
      Answer Y to enable HDF hall ak8789 sensor driver.
```
